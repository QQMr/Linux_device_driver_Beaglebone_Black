/dts-v1/;
/plugin/;

/{
	fragment@0 {
		target = <&i2c2>;
		__overlay__ {
			#address-cells = <1>;
            #size-cells = <0>;
			arduino_i2c8:arduino_i2c8@8 {
                compatible = "arduino";
                reg = <0x8>;
            };
		};
	
	};

};
