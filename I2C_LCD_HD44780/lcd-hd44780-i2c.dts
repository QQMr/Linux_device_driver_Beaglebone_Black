/dts-v1/;
/plugin/;

/{
	fragment@0 {
		target = <&i2c2>;
		__overlay__ {
			#address-cells = <1>;
            #size-cells = <0>;
			lcd_hd44780_i2c27:lcd_hd44780_i2c27@8 {
                compatible = "hd44780,lcd";
                reg = <0x27>;
            };
		};
	
	};

};
